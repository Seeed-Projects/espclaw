## main/Kconfig.projbuild
```kconfig
menu "ESPClaw Configuration"

    config ESPCLAW_WIFI_SSID
        string "WiFi SSID (testing only)"
        default ""
        help
            WiFi network name fallback. Use NVS provisioning in production.

    config ESPCLAW_WIFI_PASSWORD
        string "WiFi Password (testing only)"
        default ""

    menu "LLM Settings"
        choice ESPCLAW_LLM_BACKEND
            prompt "LLM Backend"
            default ESPCLAW_LLM_BACKEND_ANTHROPIC
            help
                Select the LLM provider. Any OpenAI-compatible endpoint
                can be used via the "Custom" option.

            config ESPCLAW_LLM_BACKEND_ANTHROPIC
                bool "Anthropic (Claude)"
            config ESPCLAW_LLM_BACKEND_OPENAI
                bool "OpenAI"
            config ESPCLAW_LLM_BACKEND_OPENROUTER
                bool "OpenRouter"
            config ESPCLAW_LLM_BACKEND_OLLAMA
                bool "Ollama (local)"
            config ESPCLAW_LLM_BACKEND_CUSTOM
                bool "Custom (OpenAI-compatible)"
        endchoice

        config ESPCLAW_LLM_BACKEND_INT
            int
            default 0 if ESPCLAW_LLM_BACKEND_ANTHROPIC
            default 1 if ESPCLAW_LLM_BACKEND_OPENAI
            default 2 if ESPCLAW_LLM_BACKEND_OPENROUTER
            default 3 if ESPCLAW_LLM_BACKEND_OLLAMA
            default 4 if ESPCLAW_LLM_BACKEND_CUSTOM

        config ESPCLAW_LLM_API_KEY
            string "API Key"
            default ""
            help
                API key for the selected LLM provider.
                Leave empty for Ollama (no auth needed).

        config ESPCLAW_LLM_BASE_URL
            string "Base URL (leave empty for default)"
            default ""
            help
                Custom endpoint URL, e.g. https://api.deepseek.com/v1
                For OpenAI-compatible providers. Leave empty to use
                the provider's official default endpoint.

        config ESPCLAW_LLM_MODEL
            string "Model name (leave empty for default)"
            default ""
            help
                Model identifier, e.g. gpt-4o-mini, claude-3-haiku-20240307,
                deepseek-chat, gemini-pro, qwen2.5:7b
                Leave empty to use the built-in default for each backend.
    endmenu

    config ESPCLAW_STUB_LLM
        bool "Stub LLM responses (offline testing)"
        default n

    config ESPCLAW_EMULATOR_MODE
        bool "Offline emulator mode"
        default n

    # =========================================================================
    # Channel Configuration
    # Enable only the channels you need to save flash and RAM.
    # =========================================================================
    menu "Channels"

        # ---------------------------------------------------------------------
        # Serial Channel
        # ---------------------------------------------------------------------
        config ESPCLAW_CHANNEL_SERIAL
            bool "Enable Serial Channel"
            default y
            help
                Serial console channel for USB/UART communication.
                This is the primary debugging interface.

        # ---------------------------------------------------------------------
        # Telegram Bot (bidirectional)
        # ---------------------------------------------------------------------
        config ESPCLAW_CHANNEL_TELEGRAM
            bool "Enable Telegram Bot"
            default n
            help
                Telegram bot channel with long polling support.
                Requires bot token from @BotFather.

        config ESPCLAW_STUB_TELEGRAM
            bool "Stub Telegram (offline testing)"
            default n
            depends on ESPCLAW_CHANNEL_TELEGRAM

        config ESPCLAW_TELEGRAM_TOKEN
            string "Telegram Bot Token"
            default ""
            depends on ESPCLAW_CHANNEL_TELEGRAM && !ESPCLAW_STUB_TELEGRAM
            help
                Bot token from @BotFather, format: 123456789:ABCdefGHIjklMNOpqrsTUVwxyz

        # ---------------------------------------------------------------------
        # DingTalk Webhook (钉钉机器人)
        # ---------------------------------------------------------------------
        config ESPCLAW_CHANNEL_DINGTALK
            bool "Enable DingTalk Webhook"
            default n
            help
                DingTalk custom robot webhook (one-way notification).
                Supports HMAC-SHA256 signing for security.

        config ESPCLAW_DINGTALK_WEBHOOK
            string "DingTalk Webhook URL"
            default ""
            depends on ESPCLAW_CHANNEL_DINGTALK
            help
                DingTalk custom robot webhook URL.
                Example: https://oapi.dingtalk.com/robot/send?access_token=xxx

        config ESPCLAW_DINGTALK_SECRET
            string "DingTalk Secret (加签密钥)"
            default ""
            depends on ESPCLAW_CHANNEL_DINGTALK
            help
                Optional secret for HMAC-SHA256 signing.
                Leave empty if using keyword security instead.

        # ---------------------------------------------------------------------
        # Discord Webhook
        # ---------------------------------------------------------------------
        config ESPCLAW_CHANNEL_DISCORD
            bool "Enable Discord Webhook"
            default n
            help
                Discord channel webhook (one-way notification).
                Create a webhook in your Discord server settings.

        config ESPCLAW_DISCORD_WEBHOOK
            string "Discord Webhook URL"
            default ""
            depends on ESPCLAW_CHANNEL_DISCORD
            help
                Discord webhook URL.
                Example: https://discord.com/api/webhooks/123456789/ABCdef...

        # ---------------------------------------------------------------------
        # Slack Webhook
        # ---------------------------------------------------------------------
        config ESPCLAW_CHANNEL_SLACK
            bool "Enable Slack Webhook"
            default n
            help
                Slack incoming webhook (one-way notification).
                Create an incoming webhook in your Slack workspace.

        config ESPCLAW_SLACK_WEBHOOK
            string "Slack Webhook URL"
            default ""
            depends on ESPCLAW_CHANNEL_SLACK
            help
                Slack incoming webhook URL.
                Example: https://hooks.slack.com/services/T000/B000/XXXX

        # ---------------------------------------------------------------------
        # WeCom Webhook (企业微信群机器人)
        # ---------------------------------------------------------------------
        config ESPCLAW_CHANNEL_WECOM
            bool "Enable WeCom Webhook"
            default n
            help
                WeCom (企业微信) group robot webhook (one-way notification).
                Supports markdown formatting.

        config ESPCLAW_WECOM_WEBHOOK
            string "WeCom Webhook URL"
            default ""
            depends on ESPCLAW_CHANNEL_WECOM
            help
                WeCom group robot webhook URL.
                Example: https://qyapi.weixin.qq.com/cgi-bin/webhook/send?key=xxx

        # ---------------------------------------------------------------------
        # Lark/Feishu Webhook (飞书机器人)
        # ---------------------------------------------------------------------
        config ESPCLAW_CHANNEL_LARK
            bool "Enable Lark/Feishu Webhook"
            default n
            help
                Lark/Feishu (飞书) custom bot webhook (one-way notification).
                Supports signature verification for security.

        config ESPCLAW_LARK_WEBHOOK
            string "Lark Webhook URL"
            default ""
            depends on ESPCLAW_CHANNEL_LARK
            help
                Lark/Feishu custom bot webhook URL.
                Example: https://open.larksuite.com/open-apis/bot/v2/hook/xxx

        config ESPCLAW_LARK_SECRET
            string "Lark Secret (签名密钥)"
            default ""
            depends on ESPCLAW_CHANNEL_LARK
            help
                Optional secret for signature verification.

        # ---------------------------------------------------------------------
        # Pushplus (推送加)
        # ---------------------------------------------------------------------
        config ESPCLAW_CHANNEL_PUSHPLUS
            bool "Enable Pushplus"
            default n
            help
                Pushplus (推送加) notification service (one-way).
                Supports WeChat, WeCom, DingTalk, Feishu, etc.
                Website: http://www.pushplus.plus/

        config ESPCLAW_PUSHPLUS_TOKEN
            string "Pushplus Token"
            default ""
            depends on ESPCLAW_CHANNEL_PUSHPLUS
            help
                Your pushplus token from the website.

        # ---------------------------------------------------------------------
        # Bark iOS Push
        # ---------------------------------------------------------------------
        config ESPCLAW_CHANNEL_BARK
            bool "Enable Bark iOS Push"
            default n
            help
                Bark iOS push notification (one-way).
                Requires Bark app installed on iPhone.
                App Store: https://apps.apple.com/app/id1403753865

        config ESPCLAW_BARK_KEY
            string "Bark Device Key"
            default ""
            depends on ESPCLAW_CHANNEL_BARK
            help
                Your Bark device key from the app.

        config ESPCLAW_BARK_SERVER
            string "Bark Server URL (optional)"
            default "https://api.day.app"
            depends on ESPCLAW_CHANNEL_BARK
            help
                Custom Bark server URL (for self-hosted).
                Default: https://api.day.app

        # ---------------------------------------------------------------------
        # MQTT Channel (bidirectional IoT control)
        # ---------------------------------------------------------------------
        config ESPCLAW_CHANNEL_MQTT
            bool "Enable MQTT Channel"
            default n
            help
                MQTT channel for bidirectional IoT communication.
                Subscribe to commands and publish responses via MQTT broker.
                Perfect for integration with Home Assistant, Node-RED, etc.

        config ESPCLAW_MQTT_BROKER_URL
            string "MQTT Broker URL"
            default "mqtt://broker.emqx.io"
            depends on ESPCLAW_CHANNEL_MQTT
            help
                MQTT broker URL. Formats:
                  - mqtt://broker.example.com:1883 (plain TCP)
                  - mqtts://broker.example.com:8883 (TLS)
                  - ws://broker.example.com:8080 (WebSocket)
                  - wss://broker.example.com:8084 (WebSocket + TLS)

                Public test brokers:
                  - mqtt://broker.emqx.io
                  - mqtt://test.mosquitto.org
                  - mqtt://broker.hivemq.com

        config ESPCLAW_MQTT_USERNAME
            string "MQTT Username (optional)"
            default ""
            depends on ESPCLAW_CHANNEL_MQTT
            help
                MQTT username for authentication. Leave empty for anonymous.

        config ESPCLAW_MQTT_PASSWORD
            string "MQTT Password (optional)"
            default ""
            depends on ESPCLAW_CHANNEL_MQTT
            help
                MQTT password for authentication. Leave empty if not needed.

    endmenu

    menu "GPIO Tool Safety"
        config ESPCLAW_GPIO_MIN_PIN
            int "Minimum GPIO pin for tools"
            range 0 48
            default 2
        config ESPCLAW_GPIO_MAX_PIN
            int "Maximum GPIO pin for tools"
            range 0 48
            default 10
        config ESPCLAW_GPIO_ALLOWED_PINS
            string "Allowed GPIO pins list (optional CSV)"
            default ""
    endmenu

    menu "I2C Configuration"
        config ESPCLAW_I2C_DEFAULT_SDA
            int "Default I2C SDA pin"
            range 0 48
            default 6
        config ESPCLAW_I2C_DEFAULT_SCL
            int "Default I2C SCL pin"
            range 0 48
            default 7
        config ESPCLAW_I2C_MAX_FREQ_HZ
            int "Max I2C frequency (Hz)"
            default 400000
    endmenu

    menu "PWM/LEDC Configuration"
        config ESPCLAW_PWM_MAX_CHANNELS
            int "Max PWM channels"
            range 1 8
            default 4
        config ESPCLAW_PWM_DEFAULT_FREQ_HZ
            int "Default PWM frequency (Hz)"
            default 5000
    endmenu

    menu "Factory Reset"
        config ESPCLAW_FACTORY_RESET_PIN
            int "Factory reset button GPIO"
            range 0 48
            default 9
        config ESPCLAW_FACTORY_RESET_HOLD_MS
            int "Factory reset hold time (ms)"
            range 1000 60000
            default 5000
    endmenu

endmenu
```

## sdkconfig.defaults.xiao_esp32c3
```kconfig
# ESPClaw for Seeed XIAO ESP32C3
# Hardware: 4MB Flash, NO PSRAM
# Target: single-core RISC-V @ 160MHz

# Size optimization (limited resources)
CONFIG_COMPILER_OPTIMIZATION_SIZE=y

# Nano printf (saves ~30KB)
CONFIG_NEWLIB_NANO_FORMAT=y

# Disable WPA3 (saves ~20KB)
CONFIG_ESP_WIFI_ENABLE_WPA3_SAE=n

# TLS content length limits (saves SRAM)
CONFIG_MBEDTLS_SSL_IN_CONTENT_LEN=16384
CONFIG_MBEDTLS_SSL_OUT_CONTENT_LEN=4096

# Task stacks (minimal)
CONFIG_ESP_MAIN_TASK_STACK_SIZE=8192
CONFIG_ESP_SYSTEM_EVENT_TASK_STACK_SIZE=4096

# Flash size
CONFIG_ESPTOOLPY_FLASHSIZE_4MB=y

# Partition table: 4MB (no OTA room)
CONFIG_PARTITION_TABLE_CUSTOM_FILENAME="partitions_4mb.csv"

# Disable unused features
CONFIG_ESP_WIFI_SOFTAP_SUPPORT=n
CONFIG_LWIP_IPV6=n
CONFIG_ESP_HTTPS_SERVER_ENABLE=n
CONFIG_LWIP_DNS_SUPPORT_MDNS_QUERIES=n
```

## sdkconfig.defaults.xiao_esp32c5
```kconfig
# ESPClaw for Seeed XIAO ESP32C5
# Hardware: 8MB Flash + 8MB Quad PSRAM
# Target: single-core RISC-V @ 240MHz, WiFi 6 (dual-band)
# Ref: https://docs.espressif.com/projects/esp-idf/en/stable/esp32c5/api-guides/external-ram.html

# Flash configuration
CONFIG_ESPTOOLPY_FLASHSIZE_8MB=y
CONFIG_ESPTOOLPY_FLASHFREQ_80M=y

# Performance optimization
CONFIG_COMPILER_OPTIMIZATION_PERF=y

# PSRAM - Quad mode (ESP32-C5 only supports Quad SPI PSRAM)
CONFIG_SPIRAM=y
CONFIG_SPIRAM_MODE_QUAD=y
CONFIG_SPIRAM_SPEED_40M=y

# Memory allocation strategy
CONFIG_SPIRAM_USE_MALLOC=y
CONFIG_SPIRAM_MALLOC_ALWAYSINTERNAL=16384

# TLS buffers with PSRAM
CONFIG_MBEDTLS_SSL_IN_CONTENT_LEN=32768
CONFIG_MBEDTLS_SSL_OUT_CONTENT_LEN=16384

# Task stacks
CONFIG_ESP_MAIN_TASK_STACK_SIZE=12288
CONFIG_ESP_SYSTEM_EVENT_TASK_STACK_SIZE=4096

# Partition table: 8MB with OTA support
CONFIG_PARTITION_TABLE_CUSTOM_FILENAME="partitions_8mb_ota.csv"

# Disable unused features to save flash (~100KB)
CONFIG_ESP_WIFI_SOFTAP_SUPPORT=n
CONFIG_LWIP_IPV6=n
CONFIG_BT_ENABLED=n
CONFIG_OPENTHREAD_ENABLED=n
CONFIG_IEEE802154_ENABLED=n
CONFIG_ESP_COREDUMP_ENABLE=n
CONFIG_ESP_GDB_SUPPORT=n
CONFIG_LOG_DEFAULT_LEVEL_WARN=y
CONFIG_LOG_DEFAULT_LEVEL=2
```
