## sdkconfig.defaults.xiao_esp32c6
```kconfig
# ESPClaw for Seeed XIAO ESP32C6
# Hardware: 4MB Flash, NO PSRAM, 512KB SRAM
# Target: single-core RISC-V @ 160MHz, WiFi 6
# Ref: https://wiki.seeedstudio.com/xiao_esp32c6_getting_started/

# Size optimization (no PSRAM, limited resources)
CONFIG_COMPILER_OPTIMIZATION_SIZE=y

# Nano printf (saves ~30KB)
CONFIG_NEWLIB_NANO_FORMAT=y

# Disable WPA3 (saves ~20KB)
CONFIG_ESP_WIFI_ENABLE_WPA3_SAE=n

# TLS content length limits (saves SRAM)
CONFIG_MBEDTLS_SSL_IN_CONTENT_LEN=16384
CONFIG_MBEDTLS_SSL_OUT_CONTENT_LEN=4096

# Task stacks (minimal)
CONFIG_ESP_MAIN_TASK_STACK_SIZE=8192
CONFIG_ESP_SYSTEM_EVENT_TASK_STACK_SIZE=4096

# Flash size
CONFIG_ESPTOOLPY_FLASHSIZE_4MB=y

# Partition table: 4MB (no OTA room)
CONFIG_PARTITION_TABLE_CUSTOM_FILENAME="partitions_4mb.csv"

# Disable unused features
CONFIG_ESP_WIFI_SOFTAP_SUPPORT=n
CONFIG_LWIP_IPV6=n
CONFIG_ESP_HTTPS_SERVER_ENABLE=n
CONFIG_LWIP_DNS_SUPPORT_MDNS_QUERIES=n
```

## sdkconfig.defaults.xiao_esp32s3
```kconfig
# ESPClaw for Seeed XIAO ESP32S3
# Hardware: 8MB Flash + 8MB Octal PSRAM (ESP32-S3R8)
# Target: dual-core Xtensa LX7 @ 240MHz
# Ref: https://docs.espressif.com/projects/esp-idf/en/stable/esp32s3/api-guides/flash_psram_config.html

# Flash configuration (Quad mode, 80MHz)
CONFIG_ESPTOOLPY_FLASHSIZE_8MB=y
CONFIG_ESPTOOLPY_FLASHFREQ_80M=y

# Performance optimization
CONFIG_COMPILER_OPTIMIZATION_PERF=y

# PSRAM - Octal mode (8MB PSRAM uses Octal/DDR mode)
CONFIG_SPIRAM=y
CONFIG_SPIRAM_MODE_OCT=y

# Memory allocation strategy
CONFIG_SPIRAM_USE_MALLOC=y
CONFIG_SPIRAM_MALLOC_ALWAYSINTERNAL=16384

# Larger buffers with PSRAM
CONFIG_MBEDTLS_SSL_IN_CONTENT_LEN=32768
CONFIG_MBEDTLS_SSL_OUT_CONTENT_LEN=16384

# Task stacks
CONFIG_ESP_MAIN_TASK_STACK_SIZE=16384
CONFIG_ESP_SYSTEM_EVENT_TASK_STACK_SIZE=8192

# Partition table: 8MB with OTA support
CONFIG_PARTITION_TABLE_CUSTOM_FILENAME="partitions_8mb_ota.csv"

# Enable HTTP server for WebSocket gateway
CONFIG_ESP_HTTPS_SERVER_ENABLE=y

# Disable unused features to save flash (~100KB)
CONFIG_ESP_WIFI_SOFTAP_SUPPORT=n
CONFIG_LWIP_IPV6=n
CONFIG_BT_ENABLED=n
CONFIG_OPENTHREAD_ENABLED=n
CONFIG_IEEE802154_ENABLED=n
CONFIG_ESP_COREDUMP_ENABLE=n
CONFIG_ESP_GDB_SUPPORT=n
CONFIG_LOG_DEFAULT_LEVEL_WARN=y
CONFIG_LOG_DEFAULT_LEVEL=2
```

## sdkconfig.defaults.xiao_esp32s3_plus
```kconfig
# ESPClaw for Seeed XIAO ESP32S3 Plus (大容量版)
# Hardware: 16MB Flash + 8MB Octal PSRAM
# Target: dual-core Xtensa LX7 @ 240MHz
# Ref: https://wiki.seeedstudio.com/xiao_esp32s3_getting_started/

# Flash configuration (Quad mode, 80MHz)
CONFIG_ESPTOOLPY_FLASHSIZE_16MB=y
CONFIG_ESPTOOLPY_FLASHFREQ_80M=y

# Performance optimization
CONFIG_COMPILER_OPTIMIZATION_PERF=y

# PSRAM - Octal mode (8MB PSRAM uses Octal/DDR mode)
CONFIG_SPIRAM=y
CONFIG_SPIRAM_MODE_OCT=y

# Memory allocation strategy
CONFIG_SPIRAM_USE_MALLOC=y
CONFIG_SPIRAM_MALLOC_ALWAYSINTERNAL=16384

# Larger buffers with PSRAM
CONFIG_MBEDTLS_SSL_IN_CONTENT_LEN=32768
CONFIG_MBEDTLS_SSL_OUT_CONTENT_LEN=16384

# Task stacks
CONFIG_ESP_MAIN_TASK_STACK_SIZE=16384
CONFIG_ESP_SYSTEM_EVENT_TASK_STACK_SIZE=8192

# Partition table: 16MB with OTA and LittleFS (from existing file)
CONFIG_PARTITION_TABLE_CUSTOM_FILENAME="partitions_16mb.csv"

# Enable HTTP server for WebSocket gateway
CONFIG_ESP_HTTPS_SERVER_ENABLE=y

# Disable unused features to save flash
CONFIG_ESP_WIFI_SOFTAP_SUPPORT=n
CONFIG_LWIP_IPV6=n
CONFIG_BT_ENABLED=n
CONFIG_OPENTHREAD_ENABLED=n
CONFIG_IEEE802154_ENABLED=n
CONFIG_ESP_COREDUMP_ENABLE=n
CONFIG_ESP_GDBSTUB_ENABLED=n
CONFIG_LOG_DEFAULT_LEVEL_WARN=y
CONFIG_LOG_DEFAULT_LEVEL=2
```

## sdkconfig.defaults.xiao_esp32s3_sense
```kconfig
# ESPClaw for Seeed XIAO ESP32S3 Sense (带摄像头和SD卡槽)
# Hardware: 8MB Flash + 8MB Octal PSRAM + SD Card Slot (32GB FAT)
# Target: dual-core Xtensa LX7 @ 240MHz
# Ref: https://wiki.seeedstudio.com/xiao_esp32s3sense_getting_started/

# Flash configuration (Quad mode, 80MHz)
CONFIG_ESPTOOLPY_FLASHSIZE_8MB=y
CONFIG_ESPTOOLPY_FLASHFREQ_80M=y

# Performance optimization
CONFIG_COMPILER_OPTIMIZATION_PERF=y

# PSRAM - Octal mode (8MB PSRAM uses Octal/DDR mode)
CONFIG_SPIRAM=y
CONFIG_SPIRAM_MODE_OCT=y

# Memory allocation strategy
CONFIG_SPIRAM_USE_MALLOC=y
CONFIG_SPIRAM_MALLOC_ALWAYSINTERNAL=16384

# Larger buffers with PSRAM (Sense has camera, needs more memory)
CONFIG_MBEDTLS_SSL_IN_CONTENT_LEN=32768
CONFIG_MBEDTLS_SSL_OUT_CONTENT_LEN=16384

# Task stacks
CONFIG_ESP_MAIN_TASK_STACK_SIZE=16384
CONFIG_ESP_SYSTEM_EVENT_TASK_STACK_SIZE=8192

# Partition table: 8MB with OTA support
CONFIG_PARTITION_TABLE_CUSTOM_FILENAME="partitions_8mb_ota.csv"

# Enable HTTP server for WebSocket gateway
CONFIG_ESP_HTTPS_SERVER_ENABLE=y

# SD Card support (Sense has SD card slot)
CONFIG_FATFS_LONG_FILENAMES=y

# Disable unused features to save flash
CONFIG_ESP_WIFI_SOFTAP_SUPPORT=n
CONFIG_LWIP_IPV6=n
CONFIG_BT_ENABLED=n
CONFIG_OPENTHREAD_ENABLED=n
CONFIG_IEEE802154_ENABLED=n
CONFIG_ESP_COREDUMP_ENABLE=n
CONFIG_ESP_GDBSTUB_ENABLED=n
CONFIG_LOG_DEFAULT_LEVEL_WARN=y
CONFIG_LOG_DEFAULT_LEVEL=2
```
